## Kconfig
```kconfig
config DRM_USER
	tristate "Support for userspace DRM drivers"
	depends on DRM
	select DRM_KMS_HELPER
	select DRM_KMS_CMA_HELPER
	select VIDEOMODE_HELPERS
	help
	  Choose this option if you have a userspace DRM driver.
	  If M is selected the module will be called tinydrm.
```
